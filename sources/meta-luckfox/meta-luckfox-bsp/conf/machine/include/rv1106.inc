## sources/meta-luckfox/meta-luckfox-bsp/recipes-bsp/u-boot/files/u-boot-rv1106.its
```
/dts-v1/;

/ {
	description = "U-Boot FIT for RV1106";
	#address-cells = <1>;

	images {
		uboot {
			description = "U-Boot";
			data = /incbin/("u-boot-nodtb.bin.lzma");
			type = "standalone";
			arch = "arm";
			os = "U-Boot";
			compression = "lzma";
			load = <0x00200000>;
			digest {
				value = /incbin/("u-boot-nodtb.bin.digest");
				algo = "sha256";
			};
			hash {
				algo = "sha256";
			};
		};

		fdt {
			description = "U-Boot dtb";
			data = /incbin/("u-boot.dtb");
			type = "flat_dt";
			arch = "arm";
			compression = "none";
			hash {
				algo = "sha256";
			};
		};
	};

	configurations {
		default = "conf";
		conf {
			description = "rv1106";
			rollback-index = <0x0>;
			loadables = "uboot";
			fdt = "fdt";
		};
	};
};
```

## sources/meta-luckfox/meta-luckfox-bsp/recipes-kernel/linux/files/boot.its
```
/*
 * FIT boot.img loaded by the Rockchip vendor U-Boot boot_fit command from
 * the "boot" partition.
 *
 * Based on boot.its from rockchip-linux/kernel develop-6.12. The load and
 * entry addresses are placeholders that U-Boot replaces at boot.
 */

/dts-v1/;
/ {
	description = "FIT image with Linux kernel, FDT blob and resource";

	images {
		fdt {
			data = /incbin/("fdt");
			type = "flat_dt";
			arch = "arm";
			compression = "none";
			load = <0xffffff00>;

			hash {
				algo = "sha256";
			};
		};

		kernel {
			data = /incbin/("kernel");
			type = "kernel";
			arch = "arm";
			os = "linux";
			compression = "none";
			entry = <0xffffff01>;
			load = <0xffffff01>;

			hash {
				algo = "sha256";
			};
		};

		resource {
			data = /incbin/("resource");
			type = "multi";
			arch = "arm";
			compression = "none";

			hash {
				algo = "sha256";
			};
		};
	};

	configurations {
		default = "conf";

		conf {
			rollback-index = <0x00>;
			fdt = "fdt";
			kernel = "kernel";
			multi = "resource";
		};
	};
};
```

## sources/meta-luckfox/meta-luckfox-bsp/wic/rv1106-emmc.wks
```
part --source rawcopy --sourceparams="file=idblock.img" --part-name idblock --offset 32K --fixed-size 512K
part --source rawcopy --sourceparams="file=uboot.img" --part-name uboot --offset 544K --fixed-size 256K
part --source empty --part-name env --offset 800K --fixed-size 32K
part / --source rootfs --fstype ext4 --label rootfs --part-name rootfs --align 1024

bootloader --ptable gpt
```

## sources/meta-luckfox/meta-luckfox-distro/conf/distro/luckfox.conf
```bitbake
# Luckfox Distro
#
# sources/yocto-docs/documentation/dev-manual/custom-distribution.rst

DISTRO = "luckfox"
DISTRO_NAME = "Luckfox Linux"
# TODO: populate this from git repo version
DISTRO_VERSION = "v0.1.0"
DISTRO_CODENAME = "wrynose"
SDK_VENDOR = "-luckfoxsdk"
SDK_VERSION = "${DISTRO_VERSION}"

TARGET_VENDOR = "-luckfox"

TCLIBC = "glibc"
INIT_MANAGER = "systemd"

# Audio through the on-SoC codec
DISTRO_FEATURES = "alsa"
# SKI.WB800DCS module: Bluetooth over UART1_M0
DISTRO_FEATURES += "bluetooth"
# ext2/3/4 root filesystem on the eMMC
DISTRO_FEATURES += "ext2"
# Networking over Ethernet and Wi-Fi
DISTRO_FEATURES += "ipv4 ipv6"
# Large file support
DISTRO_FEATURES += "largefile"
# Seccomp filtering for systemd services
DISTRO_FEATURES += "seccomp"
# USB Type-C port as device/OTG
DISTRO_FEATURES += "usbgadget"
# USB Type-A port as host
DISTRO_FEATURES += "usbhost"
# FAT support for the vendor update flow
DISTRO_FEATURES += "vfat"
# SKI.WB800DCS module: Wi-Fi over SDIO
DISTRO_FEATURES += "wifi"
# Extended attributes on the root filesystem
DISTRO_FEATURES += "xattr"

PACKAGE_CLASSES ?= "package_rpm"
```
